#include <time.h>                   // For time-related functions (NTP)
#include <WiFi.h>                   // For WiFi connectivity
#include <ESP_Mail_Client.h>        // For sending emails via SMTP
#include <HTTPClient.h>


// Motor control pins
#define ENA 25                      // PWM control pin for motor speed
#define IN1 26                      // Motor direction control pin 1
#define IN2 27                      // Motor direction control pin 2

// Input pins
#define BUTTON_PIN 14              // Push button to start/stop motor
#define SENSOR_DIGITAL 15          // Digital output from alcohol sensor
#define SENSOR_ANALOG 34           // Analog output from alcohol sensor

bool motorRunning = false;         // Flag to keep track of motor state
bool lastButtonState = HIGH;      // To detect button press change

// WiFi credentials
const char* ssid = "RealmeNarzo";
const char* password = "Hi@12345";

//thinkspeak credentials
const char* thingSpeakApiKey = "QC8O5CVH7P7XIP41";
const char* thingSpeakURL = "http://api.thingspeak.com/update";

//SMTP server and email configuration
#define SMTP_HOST "smtp.gmail.com"
#define SMTP_PORT 465

#define AUTHOR_EMAIL "alcoholdetector7@gmail.com"         // Sender email
#define AUTHOR_PASSWORD "sqlr ldmx wgct pila"             // Gmail App Password
#define RECIPIENT_EMAIL "ecs.crce.10127@gmail.com"        // Recipient email

//SMTP session and email message object
SMTPSession smtp;
SMTP_Message message;

void sendToThingSpeak(String timestamp) {
  HTTPClient http;

  //URL encode values
  String regNum = "MH12AB1234";
  String owner = "Mrmanglamjaiswal";
  String license = "DL042021007";
  String vehicle = "Car";
  String sysID = "ASVS9821";
  String imei = "356938035643809";

  String url = String(thingSpeakURL) + "?api_key=" + thingSpeakApiKey +
               "&field1=" + regNum +
               "&field2=" + owner +
               "&field3=" + license +
               "&field4=" + vehicle +
               "&field5=" + sysID +
               "&field6=" + imei;

  Serial.println("Sending to ThingSpeak: " + url);

  http.begin(url);
  int httpCode = http.GET();

  if (httpCode > 0) {
    Serial.println("ThingSpeak response code: " + String(httpCode));
    if (httpCode == 200) {
      String response = http.getString();
      Serial.println("ThingSpeak response: " + response);
    } else {
      Serial.println("ThingSpeak error response: " + http.getString());
    }
  } else {
    Serial.println("Error connecting to ThingSpeak");
  }
  http.end();
}

//Function to send an alert email when alcohol is detected
String sendEmail() {
  smtp.debug(1);

  ESP_Mail_Session session;
  session.server.host_name = SMTP_HOST;
  session.server.port = SMTP_PORT;
  session.login.email = AUTHOR_EMAIL;
  session.login.password = AUTHOR_PASSWORD;
  session.login.user_domain = "";

  message.sender.name = "ESP32 Alcohol Detector";
  message.sender.email = AUTHOR_EMAIL;
  message.subject = "🚨 Alert: Alcohol Detected in Vehicle - Immediate Attention Required";
  message.addRecipient("Traffic Control Department", RECIPIENT_EMAIL);

  time_t now = time(nullptr);
  struct tm timeinfo;
  localtime_r(&now, &timeinfo);
  char timeStr[30];
  strftime(timeStr, sizeof(timeStr), "%Y-%m-%d %H:%M:%S IST", &timeinfo);

  String htmlMsg = "<div style='font-family: Arial, sans-serif; color: #333;'>"
                   "<h2 style='color:red;'>🚨 Alert: Alcohol Detected in Vehicle - Immediate Attention Required</h2>"
                   "<p>Dear Traffic Control Department,</p>"
                   "<p>This is an automated alert from the <b>Alco-Safe Vehicle Monitoring System</b>.</p>"
                   "<p>Alcohol consumption has been detected from the driver of the following vehicle:</p>"
                   "<hr>"
                   "<h3>📝 Vehicle Details:</h3>"
                   "<ul>"
                   "<li><b>Registration Number:</b> MH12AB1234</li>"
                   "<li><b>Owner Name:</b> Mr. Manglam Jaiswal</li>"
                   "<li><b>License Number:</b> DL042021007</li>"
                   "<li><b>Vehicle Type:</b> Private (Car)</li>"
                   "</ul>"
                   "<h3>📅 Detection Timestamp:</h3>"
                   "<p>" + String(timeStr) + "</p>"
                   "<hr>"
                   "<p>We request immediate action to prevent potential road accidents and ensure public safety.</p>"
                   "<p>This alert was generated by the onboard alcohol detection system installed in the vehicle, which continuously monitors the driver's sobriety and reports violations in real-time.</p>"
                   "<hr>"
                   "<h3>📟 System Info:</h3>"
                   "<ul>"
                   "<li><b>System ID:</b> ASVS-9821</li>"
                   "<li><b>Device IMEI:</b> 356938035643809</li>"
                   "</ul>"
                   "<p>Thank you for your prompt attention.</p>"
                   "<p><b>Sincerely,</b><br>"
                   "Alco-Safe Vehicle Alert System<br>🚗🛑 Ensuring Safe Roads for All</p>"
                   "</div>";


  message.html.content = htmlMsg.c_str();
  message.html.content_type = "text/html";

  if (!smtp.connect(&session)) return String(timeStr);  // Return timestamp even if email fails

  if (!MailClient.sendMail(&smtp, &message)) {
    Serial.println("Error sending Email, " + smtp.errorReason());
  } else {
    Serial.println("Email sent successfully.");
  }

  smtp.closeSession();
  return String(timeStr);  // Return timestamp
}


void setup() {
  Serial.begin(115200);

  //Set motor and input pin modes
  pinMode(IN1, OUTPUT);
  pinMode(IN2, OUTPUT);
  pinMode(BUTTON_PIN, INPUT_PULLUP);
  pinMode(SENSOR_DIGITAL, INPUT);

  //Initialize PWM channel for motor speed control
  ledcAttach(ENA, 1000, 8);  //ENA pin, 1kHz frequency, 8-bit resolution

  //Connect to WiFi
  WiFi.begin(ssid, password);
  Serial.print("Connecting to WiFi");
  while (WiFi.status() != WL_CONNECTED) {
    delay(500);
    Serial.print(".");
  }
  Serial.println("\nWiFi connected.");
  Serial.print("IP Address: ");
  Serial.println(WiFi.localIP());

  //Configure NTP time to Indian Standard Time (UTC +5:30)
  configTime(19800, 0, "pool.ntp.org", "time.nist.gov");
  Serial.print("Waiting for NTP time sync");
  time_t now = time(nullptr);
  while (now < 8 * 3600 * 2) {
    delay(500);
    Serial.print(".");
    now = time(nullptr);
  }
  Serial.println("\nTime synchronized.");
  struct tm timeinfo;
  gmtime_r(&now, &timeinfo);
  Serial.print("Current time: ");
  Serial.println(asctime(&timeinfo));
}

void loop() {
  //Read button state to toggle motor
  bool currentButtonState = digitalRead(BUTTON_PIN);

  //Detect button press
  if (lastButtonState == HIGH && currentButtonState == LOW) {
    if (!motorRunning) {
      //Start motor
      digitalWrite(IN1, HIGH);
      digitalWrite(IN2, LOW);
      ledcWrite(ENA, 255);
      Serial.println("Motor started");
      motorRunning = true;
    } else {
      //Stop motor
      digitalWrite(IN1, LOW);
      digitalWrite(IN2, LOW);
      ledcWrite(ENA, 0);
      Serial.println("Motor stopped by button");
      motorRunning = false;
    }
    delay(300);
  }

  lastButtonState = currentButtonState;  //Update button state

  //Read alcohol sensor values
  int analogValue = analogRead(SENSOR_ANALOG);
  int digitalValue = digitalRead(SENSOR_DIGITAL);

  Serial.print("Analog value: ");
  Serial.print(analogValue);
  Serial.print("\tDigital value: ");
  Serial.println(digitalValue);


  //If alcohol is detected while the motor is running
  if (motorRunning && digitalValue == LOW) {
    Serial.println("Alcohol detected! Stopping motor and sending alert...");

    //Gradually slow down motor for safety
    for (int speed = 255; speed >= 0; speed -= 5) {
      ledcWrite(ENA, speed);
      delay(50);
    }

    //Stop motor completely
    digitalWrite(IN1, LOW);
    digitalWrite(IN2, LOW);
    motorRunning = false;

    //Send alert email to traffic authorities
    String timestamp = sendEmail();
    //Log data to ThingSpeak
    sendToThingSpeak(timestamp);
  }
  delay(300);
}